## config/west.yml
```yaml
manifest:
  remotes:
    - name: zmkfirmware
      url-base: https://github.com/zmkfirmware
    - name: lucordes
      url-base: https://github.com/lucordes
  projects:
    - name: zmk
      remote: lucordes
      revision: main-3.2
      import: app/west.yml
  self:
    path: config
    
```
